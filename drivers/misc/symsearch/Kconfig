## drivers/misc/symsearch/Kconfig
```kconfig
#
# Symbol Search for non-exported symbols
#

config SYMSEARCH
        tristate "Symbol search for finding un-exported symbols"
        depends on ARM
        default n
        help
```
